## components/espressif__esp-box-3/Kconfig
```kconfig
menu "Board Support Package(ESP-BOX-3)"

    config BSP_ERROR_CHECK
        bool "Enable error check in BSP"
        default y
        help
            Error check assert the application before returning the error code.

    menu "I2C"
        config BSP_I2C_NUM
            int "I2C peripheral index"
            default 1
            range 0 1
            help
                ESP32S3 has two I2C peripherals, pick the one you want to use.

        config BSP_I2C_FAST_MODE
            bool "Enable I2C fast mode"
            default y
            help
                I2C has two speed modes: normal (100kHz) and fast (400kHz).

        config BSP_I2C_CLK_SPEED_HZ
            int
            default 400000 if BSP_I2C_FAST_MODE
            default 100000
    endmenu

    menu "SPIFFS - Virtual File System"
        config BSP_SPIFFS_FORMAT_ON_MOUNT_FAIL
            bool "Format SPIFFS if mounting fails"
            default n
            help
                Format SPIFFS if it fails to mount the filesystem.

        config BSP_SPIFFS_MOUNT_POINT
            string "SPIFFS mount point"
            default "/spiffs"
            help
                Mount point of SPIFFS in the Virtual File System.

        config BSP_SPIFFS_PARTITION_LABEL
            string "Partition label of SPIFFS"
            default "storage"
            help
                Partition label which stores SPIFFS.

        config BSP_SPIFFS_MAX_FILES
            int "Max files supported for SPIFFS VFS"
            default 5
            help
                Supported max files for SPIFFS in the Virtual File System.
    endmenu

    menu "SD card - Virtual File System"
        config BSP_SD_FORMAT_ON_MOUNT_FAIL
            bool "Format SD card if mounting fails"
            default n
            help
                The SDMMC host will format (FAT) the SD card if it fails to mount the filesystem.

        config BSP_SD_MOUNT_POINT
            string "SD card mount point"
            default "/sdcard"
            help
                Mount point of the SD card in the Virtual File System

    endmenu

    menu "Display"
        config BSP_DISPLAY_BRIGHTNESS_LEDC_CH
        int "LEDC channel index"
        default 1
        range 0 7
        help
            LEDC channel is used to generate PWM signal that controls display brightness.
            Set LEDC index that should be used.

        config BSP_LCD_DRAW_BUF_HEIGHT
        int "LCD framebuf height"
        default 100
        range 10 240
        help
            Framebuf is used for lvgl rendering output.

        config BSP_LCD_DRAW_BUF_DOUBLE
        bool "LCD double framebuf"
        default n
        help
            Whether to enable double framebuf.
    endmenu
    
    config BSP_I2S_NUM
        int "I2S peripheral index"
        default 1
        range 0 1
        help
            ESP32S3 has two I2S peripherals, pick the one you want to use.
endmenu
```

## main/Kconfig.projbuild
```kconfig
menu "Willow Configuration"

config WIFI_SSID
    string "WiFi SSID"
    depends on !WILLOW_ETHERNET
    default "myssid"
    help
        SSID (network name) for Willow to connect to.

config WIFI_PASSWORD
    string "WiFi Password"
    depends on !WILLOW_ETHERNET
    default "mypassword"
    help
        WiFi password (WPA, WPA2, WPA3) for Willow to use.

        Can be left blank if the network is open.

config WILLOW_WAS_URL
    string "Willow Application Server URL"
    default "wss://was.local"
    help
        URL for your WAS instance. Supports WS and WSS.

choice WILLOW_WAKE_WORD
    # This is a typo in esp-sr
    depends on SR_WN_LOAD_MULIT_WORD
    prompt "Willow Wake Word"
    default WILLOW_WAKE_WORD_HIESP

    config WILLOW_WAKE_WORD_HIESP
        depends on SR_WN_WN9_HIESP_MULTI
        bool "Hi ESP"
        help
            Say Hi ESP to wake Willow

    config WILLOW_WAKE_WORD_ALEXA
        depends on SR_WN_WN9_ALEXA_MULTI
        bool "Alexa"
        help
            Say Alexa to wake Willow

    config WILLOW_WAKE_WORD_HILEXIN
        depends on SR_WN_WN9_HILEXIN_MULTI
        bool "Hi Lexin"
        help
            Say Hi Lexin to wake Willow
endchoice

config WILLOW_TIMEZONE
    string "Timezone"
    default "UTC+5"
    help
        Willow device timezone

config WILLOW_VOLUME
    int "Speaker volume"
    range 0 100
    default 60
    help
        Audio level for playback from 0-100

config WILLOW_LCD_BRIGHTNESS
    int "LCD Brightness"
    range 0 1023
    default 700
    help
        LCD Brightness from 0-1023

    menu "Advanced settings"

        config WILLOW_STREAM_TIMEOUT
            int "Maximum speech duration"
            range 1 30
            default 5
            help
                Stop speech recognition after N seconds after wake event to avoid endless stream when VAD END doesn't trigger.

        choice WILLOW_USE_CODEC
            prompt "Audio codec to use for speech recognition"
            default WILLOW_USE_PCM

            config WILLOW_USE_PCM
                bool "PCM"
                help
                    High bandwidth but very fast

            config WILLOW_USE_AMRWB
                bool "AMR-WB"
                help
                    AMR-WB is a very low bitrate codec

            config WILLOW_USE_WAV
                bool "WAV"
                help
                    Industry standard WAV file
        endchoice

        choice WILLOW_WAKE_MODE
            prompt "Wake Word Recognition Operating Mode"
            default WILLOW_WAKE_DET_MODE_2CH_90

                config WILLOW_WAKE_DET_MODE_90
                    bool "DET_MODE_90"

                config WILLOW_WAKE_DET_MODE_95
                    bool "DET_MODE_95"

                config WILLOW_WAKE_DET_MODE_2CH_90
                    bool "DET_MODE_2CH_90"

                config WILLOW_WAKE_DET_MODE_2CH_95
                    bool "DET_MODE_2CH_95"

                config WILLOW_WAKE_DET_MODE_3CH_90
                    bool "DET_MODE_3CH_90"

                config WILLOW_WAKE_DET_MODE_3CH_95
                    bool "DET_MODE_3CH_95"
        endchoice

        choice WILLOW_WAKE_VAD_MODE
            prompt "Voice Activity Detection Mode"
            default WILLOW_WAKE_VAD_MODE_3

                config WILLOW_WAKE_VAD_MODE_0
                    bool "VAD_MODE_0"

                config WILLOW_WAKE_VAD_MODE_1
                    bool "VAD_MODE_1"

                config WILLOW_WAKE_VAD_MODE_2
                    bool "VAD_MODE_2"

                config WILLOW_WAKE_VAD_MODE_3
                    bool "VAD_MODE_3"

                config WILLOW_WAKE_VAD_MODE_4
                    bool "VAD_MODE_4"
        endchoice

        config WILLOW_ETHERNET
        depends on ETH_SPI_ETHERNET_W5500
        bool "Ethernet support"
        help
            Ethernet support via W5500 over SPI

    endmenu

    menu "Debugging"

    config WILLOW_DEBUG_LOG
        bool "Debug Willow logging"
        help
            Set all log levels to debug

    config WILLOW_DEBUG_MEM
        bool "Debug Willow memory"
        help
            Willow will periodically print memory debugging information when enabled

    config WILLOW_DEBUG_RUNTIME_STATS
        bool "Debug Willow runtime stats"
        select FREERTOS_GENERATE_RUN_TIME_STATS
        help
            Willow will periodically print runtime stats when enabled

    config WILLOW_DEBUG_TASKS
        bool "Debug Willow tasks"
        select FREERTOS_USE_STATS_FORMATTING_FUNCTIONS
        select FREERTOS_USE_TRACE_FACILITY
        help
            Willow will periodically print task list when enabled

    config WILLOW_DEBUG_TIMERS
        bool "Debug Willow timers"
        help
            Willow will periodically print timer information when enabled

    endmenu

endmenu
```

## sdkconfig.defaults
```kconfig
#
# Bootloader config
#
CONFIG_BOOTLOADER_OFFSET_IN_FLASH=0x1000
CONFIG_BOOTLOADER_COMPILER_OPTIMIZATION_SIZE=y

#
# Serial flasher config
#
CONFIG_ESPTOOLPY_FLASHSIZE_DETECT=y
CONFIG_ESPTOOLPY_BEFORE_RESET=y
CONFIG_ESPTOOLPY_FLASHFREQ_80M=y
CONFIG_ESPTOOLPY_FLASHSIZE_4MB=y
CONFIG_ESPTOOLPY_BAUD_921600B=y
CONFIG_ESPTOOLPY_BAUD=921600
CONFIG_OPTIMIZATION_LEVEL_RELEASE=y
CONFIG_ESPTOOLPY_FLASHSIZE_4MB=y
# end of Serial flasher config

#
# Partition Table
#
CONFIG_PARTITION_TABLE_CUSTOM=y
CONFIG_PARTITION_TABLE_CUSTOM_FILENAME="partitions_raw_http_example.csv"
CONFIG_PARTITION_TABLE_FILENAME="partitions_raw_http_example.csv"
CONFIG_PARTITION_TABLE_OFFSET=0x8000
CONFIG_PARTITION_TABLE_MD5=y
# end of Partition Table
```

## sdkconfig.defaults.esp32
```kconfig
CONFIG_IDF_CMAKE=y
CONFIG_IDF_TARGET_ARCH_XTENSA=y
CONFIG_IDF_TARGET="esp32"
CONFIG_IDF_TARGET_ESP32=y
CONFIG_IDF_FIRMWARE_CHIP_ID=0x0000

#
# SDK tool configuration
#
CONFIG_SDK_TOOLPREFIX="xtensa-esp32-elf-"
# CONFIG_SDK_TOOLCHAIN_SUPPORTS_TIME_WIDE_64_BITS is not set
# end of SDK tool configuration

#
# Audio HAL
#
CONFIG_ESP_LYRAT_V4_3_BOARD=y
```

## sdkconfig.defaults.esp32s2
```kconfig
CONFIG_IDF_CMAKE=y
CONFIG_IDF_TARGET_ARCH_XTENSA=y
CONFIG_IDF_TARGET="esp32s2"
CONFIG_IDF_TARGET_ESP32S2=y
CONFIG_IDF_FIRMWARE_CHIP_ID=0x0002

#
# SDK tool configuration
#
CONFIG_SDK_TOOLPREFIX="xtensa-esp32s2-elf-"
# CONFIG_SDK_TOOLCHAIN_SUPPORTS_TIME_WIDE_64_BITS is not set
# end of SDK tool configuration

#
# Audio HAL
#
CONFIG_ESP32_S2_KALUGA_1_V1_2_BOARD=y
```

## sdkconfig.defaults.esp32s3
```kconfig
CONFIG_IDF_CMAKE=y
CONFIG_IDF_TARGET_ARCH_XTENSA=y
CONFIG_IDF_TARGET="esp32s3"
CONFIG_IDF_TARGET_ESP32S3=y
CONFIG_IDF_FIRMWARE_CHIP_ID=0x0009

#
# SDK tool configuration
#
CONFIG_SDK_TOOLPREFIX="xtensa-esp32s3-elf-"
# CONFIG_SDK_TOOLCHAIN_SUPPORTS_TIME_WIDE_64_BITS is not set
# end of SDK tool configuration

#
# Audio HAL
#
CONFIG_ESP32_S3_KORVO2_V3_BOARD=y
```
